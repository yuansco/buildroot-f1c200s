## board/yuan/f1c200s_dev_board_defconfig
```kconfig
BR2_arm=y
BR2_ARM_CPU_ARMV5=y

# Toolchain
BR2_TOOLCHAIN_BUILDROOT_GLIBC=y

# GCC Options
BR2_TOOLCHAIN_BUILDROOT_CXX=y
BR2_GCC_ENABLE_LTO=y

# GDB Options
BR2_PACKAGE_HOST_GDB=y
BR2_PACKAGE_HOST_GDB_PYTHON=y
BR2_PACKAGE_HOST_GDB_SIM=y
BR2_PACKAGE_HOST_GDB_TUI=y
BR2_PACKAGE_GDB=y
BR2_PACKAGE_GDB_SERVER=y

# Host Config
BR2_PACKAGE_HOST_PYTHON3=y
BR2_PACKAGE_HOST_PYTHON3_SSL=y
BR2_PACKAGE_HOST_UBOOT_TOOLS=y
BR2_PACKAGE_HOST_UBOOT_TOOLS_FIT_SUPPORT=y
BR2_PACKAGE_HOST_UBOOT_TOOLS_FIT_SIGNATURE_SUPPORT=y

# Bootloader
BR2_TARGET_UBOOT=y
BR2_TARGET_UBOOT_BUILD_SYSTEM_KCONFIG=y
BR2_TARGET_UBOOT_CUSTOM_VERSION=y
BR2_TARGET_UBOOT_CUSTOM_VERSION_VALUE="2020.07"
BR2_TARGET_UBOOT_NEEDS_DTC=y
BR2_TARGET_UBOOT_FORMAT_BIN=y
BR2_TARGET_UBOOT_SPL=y
BR2_TARGET_UBOOT_USE_CUSTOM_CONFIG=y
BR2_TARGET_UBOOT_SPL_NAME="u-boot-sunxi-with-spl.bin"
BR2_TARGET_UBOOT_PATCH="board/allwinner/suniv-f1c100s/patch/u-boot"

BR2_TARGET_UBOOT_CUSTOM_CONFIG_FILE="board/yuan/uboot/uboot.defconfig"
BR2_TARGET_UBOOT_CUSTOM_DTS_PATH="board/allwinner/suniv-f1c100s/devicetree/uboot/suniv-f1c100s.dtsi board/yuan/uboot/suniv-f1c100s-generic.dts"

# Kernel
BR2_LINUX_KERNEL=y
BR2_PACKAGE_HOST_LINUX_HEADERS_CUSTOM_5_4=y
BR2_LINUX_KERNEL_CUSTOM_VERSION=y
BR2_LINUX_KERNEL_CUSTOM_VERSION_VALUE="5.4.92"
BR2_LINUX_KERNEL_DTS_SUPPORT=y
BR2_LINUX_KERNEL_USE_CUSTOM_CONFIG=y
BR2_LINUX_KERNEL_PATCH="board/allwinner/suniv-f1c100s/patch/linux"

BR2_LINUX_KERNEL_CUSTOM_CONFIG_FILE="board/yuan/linux/linux.defconfig"
BR2_LINUX_KERNEL_CUSTOM_DTS_PATH="board/allwinner/suniv-f1c100s/devicetree/linux/suniv-f1c100s.dtsi board/yuan/linux/devicetree.dts"

# Filesystem
BR2_TARGET_ROOTFS_CPIO=y
BR2_TARGET_ROOTFS_CPIO_GZIP=y
BR2_TARGET_ROOTFS_EXT2=y
BR2_TARGET_ROOTFS_EXT2_4=y
BR2_TARGET_ROOTFS_EXT2_SIZE="60M"
BR2_TARGET_ROOTFS_SQUASHFS=y
BR2_TARGET_ROOTFS_SQUASHFS4_GZIP=y
BR2_PACKAGE_HOST_DOSFSTOOLS=y
BR2_PACKAGE_HOST_GENIMAGE=y
BR2_PACKAGE_HOST_MTOOLS=y
BR2_ROOTFS_POST_IMAGE_SCRIPT="board/yuan/scripts/genimage.sh"
BR2_ROOTFS_POST_SCRIPT_ARGS="${BR2_TARGET_UBOOT_SPL_NAME}"

BR2_ROOTFS_OVERLAY="board/allwinner/generic/rootfs board/allwinner/suniv-f1c100s/rootfs board/yuan/rootfs"

# Target Config
BR2_PACKAGE_UTIL_LINUX_UUIDD=y
BR2_ROOTFS_DEVICE_CREATION_DYNAMIC_EUDEV=y
BR2_PACKAGE_LIBCEDARC_ARCHLIB="toolchain-sunxi-arm9-glibc"

BR2_TARGET_GENERIC_ISSUE="Welcome to F1C200s Dev Board"
BR2_TARGET_GENERIC_HOSTNAME="f1c200s"

BR2_TARGET_GENERIC_ROOT_PASSWD="1"


# Target Package
BR2_PACKAGE_HAVEGED=y
BR2_PACKAGE_UMTPRD=y
BR2_PACKAGE_TSLIB=y
BR2_PACKAGE_FB_TEST_APP=y
BR2_PACKAGE_TINYALSA=y
BR2_PACKAGE_NANO_TINY=y
BR2_PACKAGE_USBUTILS=y

# Target Package - USB LAN/WLAN adapter support
BR2_PACKAGE_DHCPCD=y
BR2_PACKAGE_WIRELESS_TOOLS=y
BR2_PACKAGE_WIRELESS_TOOLS_LIB=y
BR2_PACKAGE_WPA_SUPPLICANT=y
BR2_PACKAGE_WPA_SUPPLICANT_AP_SUPPORT=y
BR2_PACKAGE_WPA_SUPPLICANT_WIFI_DISPLAY=y
BR2_PACKAGE_WPA_SUPPLICANT_MESH_NETWORKING=y
BR2_PACKAGE_WPA_SUPPLICANT_AUTOSCAN=y
BR2_PACKAGE_WPA_SUPPLICANT_EAP=y
BR2_PACKAGE_WPA_SUPPLICANT_HOTSPOT=y
BR2_PACKAGE_WPA_SUPPLICANT_DEBUG_SYSLOG=y
BR2_PACKAGE_WPA_SUPPLICANT_WPS=y
BR2_PACKAGE_WPA_SUPPLICANT_WPA3=y
BR2_PACKAGE_WPA_SUPPLICANT_CLI=y
BR2_PACKAGE_WPA_SUPPLICANT_WPA_CLIENT_SO=y
BR2_PACKAGE_WPA_SUPPLICANT_PASSPHRASE=y
BR2_PACKAGE_WPA_SUPPLICANT_DBUS=y
BR2_PACKAGE_LINUX_FIRMWARE=y
BR2_PACKAGE_LINUX_FIRMWARE_RTL_81XX=y
BR2_PACKAGE_OPENSSH=y
BR2_PACKAGE_HAVEGED=y

# Target Package - oled module support
BR2_PACKAGE_SSD1306_LINUX=y
```

## package/motion_angle/Config.in
```kconfig
config BR2_PACKAGE_MOTION_ANGLE
	bool "motion_angle"
	help
	  Motion Angle is a user-space program written in C, which uses the
	  Linux IIO device driver to read the three-axis acceleration of
	  the g-sensor and use it to calculate the tilt angle of the board.
	  source is https://github.com/yuansco/Motion-Angle
```

## package/ssd1306_linux/Config.in
```kconfig
config BR2_PACKAGE_SSD1306_LINUX
	bool "ssd1306_linux utility"
	help
	  OLED SSD1306 Linux driver.
	  This is plain c code using linux I2C device node (/dev/i2c-X X for 0,1,2,3...).
	  Please make sure the linux has run "modprobe i2c-dev". 128x64 and 128x32 are
	  supporting and using I2C interface ONLY
	  source is https://github.com/armlabs/ssd1306_linux
```
